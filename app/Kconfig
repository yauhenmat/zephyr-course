## app/Kconfig
```kconfig
menuconfig LED_SUBSYSTEM
    bool "LED Subsystem"
    default y

if LED_SUBSYSTEM

    choice
        prompt "LED blink sleep time"
        default BLINK_SLEEP_1000MS

    config BLINK_SLEEP_2000MS
        bool "2s (slow)"

    config BLINK_SLEEP_1000MS
        bool "1s (medium)"

    config BLINK_SLEEP_500MS
        bool "500ms (fast)"

    config BLINK_SLEEP_250MS
        bool "250ms (very fast)"

    endchoice

    config BLINK_SLEEP_TIME_MS
    int
    default 250 if BLINK_SLEEP_250MS
    default 500 if BLINK_SLEEP_500MS
    default 1000 if BLINK_SLEEP_1000MS
    default 2000 if BLINK_SLEEP_2000MS
    default 0

    menuconfig ADVANCED_LED_SETTINGS
        bool "Advanced LED settings"
        default n

    if ADVANCED_LED_SETTINGS

        config LED_BRIGHTNESS
            int "LED brightness (0-100)"
            default 100
            range 0 100

        config LED_FADE_DURATION
            int "LED fade duration (ms)"
            default 500
            range 0 5000

        menu "Expert settings"
            visible if ADVANCED_LED_SETTINGS

            config LED_DEBUG
                bool "Enable LED debugging"
            config CUSTOM_BLINK_PATTERN
                bool "Custom blink pattern"
        endmenu

    endif # ADVANCED_LED_SETTINGS

endif # LED_SUBSYSTEM

source "Kconfig.zephyr"
```

## app/boards/my_board/Kconfig.my_board
```kconfig
# Copyright (c) 2022 Joylab AG <team@joylab.ch>
# SPDX-License-Identifier: Apache-2.0

config BOARD_MY_BOARD
	select SOC_STM32G031XX
```

## app/boards/my_board/board.yml
```yaml
board:
  name: my_board
  full_name: My Board From Scratch
  vendor: iomico
  socs:
    - name: stm32g031xx
```

## app/dts/bindings/our,driver.yaml
```yaml
description: Our Simple GPIO Driver
compatible: "our,driver"
include: base.yaml
properties:
  led-gpios:
    type: phandle-array
    required: true
    description: LED GPIO
```

## dts/bindings/our,driver.yaml
```yaml
description: "Our Simple GPIO Driver"
compatible: "our,driver"
include: "base.yaml"
```
